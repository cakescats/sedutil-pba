## pba/configs/cakes_pba_defconfig
```kconfig
# CakesCats PBA, default profile
BR2_x86_64=y
BR2_x86_x86_64=y
BR2_REPRODUCIBLE=y
BR2_TOOLCHAIN_EXTERNAL=y
BR2_TOOLCHAIN_EXTERNAL_BOOTLIN=y
BR2_TOOLCHAIN_EXTERNAL_BOOTLIN_X86_64_GLIBC_STABLE=y

# system
BR2_TARGET_GENERIC_HOSTNAME="cakes-pba"
BR2_TARGET_GENERIC_ISSUE="CakesCats PBA"
BR2_INIT_BUSYBOX=y
BR2_ROOTFS_DEVICE_CREATION_DYNAMIC_DEVTMPFS=y
# BR2_TARGET_ENABLE_ROOT_LOGIN is not set
# BR2_TARGET_GENERIC_GETTY is not set
# BR2_PACKAGE_IFUPDOWN_SCRIPTS is not set
BR2_SYSTEM_DHCP=""
BR2_ROOTFS_OVERLAY="$(BR2_EXTERNAL_CAKES_PBA_PATH)/board/cakes-pba/rootfs-overlay"
BR2_ROOTFS_POST_BUILD_SCRIPT="$(BR2_EXTERNAL_CAKES_PBA_PATH)/board/cakes-pba/post-build.sh"
BR2_ROOTFS_POST_IMAGE_SCRIPT="$(BR2_EXTERNAL_CAKES_PBA_PATH)/board/cakes-pba/post-image.sh"
BR2_ROOTFS_POST_SCRIPT_ARGS="default"

# kernel: LTS, x86_64 defconfig trimmed down by the fragment
BR2_LINUX_KERNEL=y
BR2_LINUX_KERNEL_CUSTOM_VERSION=y
BR2_LINUX_KERNEL_CUSTOM_VERSION_VALUE="6.18.60"
BR2_LINUX_KERNEL_USE_DEFCONFIG=y
BR2_LINUX_KERNEL_DEFCONFIG="x86_64"
BR2_LINUX_KERNEL_CONFIG_FRAGMENT_FILES="$(BR2_EXTERNAL_CAKES_PBA_PATH)/board/cakes-pba/linux.fragment"
BR2_LINUX_KERNEL_NEEDS_HOST_OPENSSL=y
BR2_LINUX_KERNEL_NEEDS_HOST_LIBELF=y

# packages
BR2_PACKAGE_CAKES_SEDUTIL=y

# initramfs, loaded by GRUB next to the kernel
BR2_TARGET_ROOTFS_CPIO=y
BR2_TARGET_ROOTFS_CPIO_XZ=y
# BR2_TARGET_ROOTFS_TAR is not set

# bootloader and image
BR2_TARGET_GRUB2=y
BR2_TARGET_GRUB2_X86_64_EFI=y
BR2_TARGET_GRUB2_BUILTIN_MODULES_EFI="boot linux fat part_gpt part_msdos normal efi_gop efi_uga all_video echo test sleep reboot efifwsetup configfile search search_label"
BR2_PACKAGE_HOST_DOSFSTOOLS=y
BR2_PACKAGE_HOST_GENIMAGE=y
BR2_PACKAGE_HOST_MTOOLS=y
```

## pba/package/cakes-sedutil/Config.in
```kconfig
config BR2_PACKAGE_CAKES_SEDUTIL
	bool "cakes-sedutil"
	depends on BR2_INSTALL_LIBSTDCPP
	help
	  sedutil-cli and the CakesCats linuxpba, built from this
	  repository.

	  https://github.com/cakescats/sedutil-pba

comment "cakes-sedutil needs a toolchain w/ C++"
	depends on !BR2_INSTALL_LIBSTDCPP
```
